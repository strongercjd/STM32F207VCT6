
#include "LCD_disp.h"

//画笔颜色以及背景色	   
uint16_t POINT_COLOR;
uint16_t BACK_COLOR;

//8*16 ASCII字库集点阵
const unsigned char ASCII_0816[95][16]={	  
  {0x00,0x00,0x00,0x00,0x00,0x00,0x00,0x00,0x00,0x00,0x00,0x00,0x00,0x00,0x00,0x00},/*" ",0*/
  {0x00,0x00,0x00,0x00,0x00,0x00,0x1F,0xCC,0x00,0x0C,0x00,0x00,0x00,0x00,0x00,0x00},/*"!",1*/
  {0x00,0x00,0x08,0x00,0x30,0x00,0x60,0x00,0x08,0x00,0x30,0x00,0x60,0x00,0x00,0x00},/*""",2*/
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  {0x00,0x00,0x60,0x00,0x80,0x00,0x80,0x00,0x40,0x00,0x40,0x00,0x20,0x00,0x20,0x00},/*"~",94*/
}; 

extern void SysCtlDelay(unsigned long ulCount);


/**
* @brief  初始化函数
* @param  无
* @retval 无
*/
void LCD_Init ( void )
{
  LMT028_Init ();	
}


/**
* @brief  LMT028初始化函数，如果用到lcd 要调用该函数
* @param  无
* @retval 无
*/
void LMT028_Init ( void )
{
  LMT028_GPIO_Config ();
  LMT028_FSMC_Config ();
  
  timer3_init();
  
  LMT028_Rst ();
  LMT028_REG_Config ();
  
  Set_Pen_Color(LCD_red);
  Set_Back_Color(LCD_black);
}


void LMT028_GPIO_Config ()
{
  GPIO_InitTypeDef  GPIO_InitStructure;
  
  RCC_AHB1PeriphClockCmd(RCC_AHB1Periph_GPIOC|RCC_AHB1Periph_GPIOD|RCC_AHB1Periph_GPIOE,ENABLE);
  
  /* 配置控制线
  * PD14  :D0
  * PD15  :D1
  * PD0   :D2
  * PD1   :D3
  * PE7   :D4
  * PE8   :D5
  * PE9   :D6
  * PE10  :D7
  */
  
  GPIO_InitStructure.GPIO_Pin=GPIO_Pin_0|GPIO_Pin_1|GPIO_Pin_14|GPIO_Pin_15;
  GPIO_InitStructure.GPIO_Speed=GPIO_Speed_50MHz;
  GPIO_InitStructure.GPIO_Mode=GPIO_Mode_AF;
  GPIO_InitStructure.GPIO_OType = GPIO_OType_PP;
  GPIO_InitStructure.GPIO_PuPd = GPIO_PuPd_UP;
  GPIO_Init(GPIOD,&GPIO_InitStructure);
  
  GPIO_PinAFConfig(GPIOD, GPIO_PinSource0 , GPIO_AF_FSMC);
  GPIO_PinAFConfig(GPIOD, GPIO_PinSource1 , GPIO_AF_FSMC);
  GPIO_PinAFConfig(GPIOD, GPIO_PinSource14 , GPIO_AF_FSMC);
  GPIO_PinAFConfig(GPIOD, GPIO_PinSource15 , GPIO_AF_FSMC);
  
  
  GPIO_InitStructure.GPIO_Pin=GPIO_Pin_7|GPIO_Pin_8|GPIO_Pin_9|GPIO_Pin_10;
  GPIO_Init(GPIOE,&GPIO_InitStructure);
  
  GPIO_PinAFConfig(GPIOE, GPIO_PinSource7 , GPIO_AF_FSMC);
  GPIO_PinAFConfig(GPIOE, GPIO_PinSource8 , GPIO_AF_FSMC);
  GPIO_PinAFConfig(GPIOE, GPIO_PinSource9 , GPIO_AF_FSMC);
  GPIO_PinAFConfig(GPIOE, GPIO_PinSource10 , GPIO_AF_FSMC);
  
  /* 配置控制线
  * PD4-FSMC_NOE   :LCD-RD
  * PD5-FSMC_NWE   :LCD-WR
  * PD7-FSMC_NE1   :LCD-CS
  * PD11-FSMC_A16  :LCD-DC
  */
  
  
  GPIO_InitStructure.GPIO_Pin=LCD_RD_Pin|LCD_WR_Pin|LCD_CS_Pin|LCD_DC_Pin;
  GPIO_Init(GPIOD,&GPIO_InitStructure);
  
  GPIO_PinAFConfig(GPIOD, GPIO_PinSource4 , GPIO_AF_FSMC);
  GPIO_PinAFConfig(GPIOD, GPIO_PinSource5 , GPIO_AF_FSMC);
  GPIO_PinAFConfig(GPIOD, GPIO_PinSource7 , GPIO_AF_FSMC);
  GPIO_PinAFConfig(GPIOD, GPIO_PinSource11 , GPIO_AF_FSMC);
  
  /* 配置LCD复位RST控制用脚 PC6*/     
  RCC_AHB1PeriphClockCmd(RCC_AHB1Periph_GPIOC,ENABLE);
  GPIO_InitStructure.GPIO_Pin=LCD_RST_Pin;
  GPIO_InitStructure.GPIO_Speed=GPIO_Speed_50MHz;
  GPIO_InitStructure.GPIO_Mode=GPIO_Mode_OUT;
  GPIO_InitStructure.GPIO_OType = GPIO_OType_PP;
  GPIO_InitStructure.GPIO_PuPd = GPIO_PuPd_UP;
  
  GPIO_Init(GPIOC,&GPIO_InitStructure);
  
  
  /* 配置LCD背光BK控制用脚 PC7*/  
  
  GPIO_PinAFConfig(GPIOC,LCD_BK_Pin,GPIO_AF_TIM3);
  
  GPIO_InitStructure.GPIO_Pin=LCD_BK_Pin;
  GPIO_InitStructure.GPIO_Speed=GPIO_Speed_50MHz;
  GPIO_InitStructure.GPIO_Mode=GPIO_Mode_AF;
  GPIO_InitStructure.GPIO_OType = GPIO_OType_PP;
  GPIO_InitStructure.GPIO_PuPd = GPIO_PuPd_UP;
  
  GPIO_Init(GPIOC,&GPIO_InitStructure);
  
  /* Connect TIM3 pins to PC7 */  
  GPIO_PinAFConfig(GPIOC, GPIO_PinSource7, GPIO_AF_TIM3);
  
}



void set_bk_value(uint16_t value)
{
  TIM_SetCompare2(TIM3,value);
}


/**
* @brief  LCD  FSMC 模式配置
* @param  无
* @retval 无
*/
void LMT028_FSMC_Config ( void )
{
  FSMC_NORSRAMInitTypeDef  FSMC_NORSRAMInitStructure;
  FSMC_NORSRAMTimingInitTypeDef  readWriteTiming;  
  
  /* Enable FSMC clock */
  RCC_AHB3PeriphClockCmd(RCC_AHB3Periph_FSMC, ENABLE); 
  
  /*AHB clock is 120000000*/
  readWriteTiming.FSMC_AddressSetupTime = 0x02;	 //地址建立时间（ADDSET）为2个HCLK 2*1/120M=16ns
  readWriteTiming.FSMC_AddressHoldTime = 0x02;	 //地址保持时间（ADDHLD）,16ns	
  readWriteTiming.FSMC_DataSetupTime = 0x06;     //数据建立时间，50ns
  readWriteTiming.FSMC_BusTurnAroundDuration = 0x00;//总线恢复时间
  readWriteTiming.FSMC_CLKDivision = 0x00;// 时钟分频因子 
  readWriteTiming.FSMC_DataLatency = 0x00;//数据产生时间
  readWriteTiming.FSMC_AccessMode = FSMC_AccessMode_A;	 //模式A 
  
  
  FSMC_NORSRAMInitStructure.FSMC_Bank = FSMC_Bank1_NORSRAM1;//  这里我们使用NE1 ，也就对应BTCR[6],[7]。
  FSMC_NORSRAMInitStructure.FSMC_DataAddressMux = FSMC_DataAddressMux_Disable;// 不复用数据地址
  FSMC_NORSRAMInitStructure.FSMC_MemoryType = FSMC_MemoryType_SRAM;// FSMC_MemoryType_SRAM; 
  FSMC_NORSRAMInitStructure.FSMC_MemoryDataWidth = FSMC_MemoryDataWidth_8b;//存储器数据宽度为8bit   
  FSMC_NORSRAMInitStructure.FSMC_BurstAccessMode = FSMC_BurstAccessMode_Disable;// FSMC_BurstAccessMode_Disable; 
  FSMC_NORSRAMInitStructure.FSMC_AsynchronousWait = FSMC_AsynchronousWait_Disable;  
  FSMC_NORSRAMInitStructure.FSMC_WaitSignalPolarity = FSMC_WaitSignalPolarity_Low;
  FSMC_NORSRAMInitStructure.FSMC_WrapMode = FSMC_WrapMode_Disable;
  FSMC_NORSRAMInitStructure.FSMC_WaitSignalActive = FSMC_WaitSignalActive_BeforeWaitState;
  FSMC_NORSRAMInitStructure.FSMC_WriteOperation = FSMC_WriteOperation_Enable;//  存储器写使能
  FSMC_NORSRAMInitStructure.FSMC_WaitSignal = FSMC_WaitSignal_Disable;
  FSMC_NORSRAMInitStructure.FSMC_ExtendedMode = FSMC_ExtendedMode_Disable;// 读写使用相同的时序
  FSMC_NORSRAMInitStructure.FSMC_WriteBurst = FSMC_WriteBurst_Disable;
  FSMC_NORSRAMInitStructure.FSMC_ReadWriteTimingStruct = &readWriteTiming;//读写时序
  FSMC_NORSRAMInitStructure.FSMC_WriteTimingStruct = &readWriteTiming;//写时序
  
  
  FSMC_NORSRAMInit(&FSMC_NORSRAMInitStructure);  //初始化FSMC配置
  
  FSMC_NORSRAMCmd(FSMC_Bank1_NORSRAM1, ENABLE);
}


/**
* @brief  作为LCD的背光输出PWM.
* @param  None
* @retval None
*/
void timer3_init(void)
{
  TIM_TimeBaseInitTypeDef TIM_TimeBaseStructure;
  TIM_OCInitTypeDef  TIM_OCInitStructure;
  
  RCC_APB1PeriphClockCmd(RCC_APB1Periph_TIM3, ENABLE);
  
  TIM_TimeBaseStructure.TIM_Period = 500;
  TIM_TimeBaseStructure.TIM_Prescaler = (uint16_t) ((SystemCoreClock /2) / 100000) - 1;
  TIM_TimeBaseStructure.TIM_ClockDivision = 0;
  TIM_TimeBaseStructure.TIM_CounterMode = TIM_CounterMode_Up;
  
  TIM_TimeBaseInit(TIM3, &TIM_TimeBaseStructure);
  
  /* PWM1 Mode configuration: Channel2 */
  TIM_OCInitStructure.TIM_OCMode = TIM_OCMode_PWM1;
  TIM_OCInitStructure.TIM_OutputState = TIM_OutputState_Enable;
  TIM_OCInitStructure.TIM_Pulse = 249;//CCR2_Val;
  TIM_OCInitStructure.TIM_OCPolarity = TIM_OCPolarity_High;
  
  TIM_OC2Init(TIM3, &TIM_OCInitStructure);
  
  TIM_OC2PreloadConfig(TIM3, TIM_OCPreload_Enable);
  
  TIM_Cmd(TIM3, ENABLE);
  
}


/**
* @brief  LMT028 软件复位
* @param  无
* @retval 无
*/
void LMT028_Rst ( void )
{			
  GPIO_ResetBits ( LCD_RST_GPIO, LCD_RST_Pin );	 
  
  Delay1ms(80);				   
  
  GPIO_SetBits ( LCD_RST_GPIO, LCD_RST_Pin );		 	 
  
  Delay1ms(80);		
}




/**
* @brief 设置坐标
* @param  X/Y:起始坐标 
* @retval 无
*/
void set_coordinate(uint16_t x,uint16_t y )
{
  uint8_t x_l,x_h,y_l,y_h;
  
  x_l=(x&0xff);
  x_h=((x>>8)&0xff);
  y_l=(y&0xff);
  y_h=((y>>8)&0xff);
  
  LMT028_Write_Cmd(0x2a); 
  LMT028_Write_Data(x_h);
  LMT028_Write_Data(x_l);
  
  LMT028_Write_Cmd(0x2b); 
  LMT028_Write_Data(y_h);
  LMT028_Write_Data(y_l); 
}

/**
* @brief 设置窗体
* @param  X/Y:起始坐标   width：区域宽度  height;区域高度  
* @retval 无
*/

void set_windows(uint16_t X,uint16_t Y,uint16_t width,uint16_t height)
{
  uint8_t X_l,X_h,Y_l,Y_h;
  uint8_t width_l,width_h,height_l,height_h;
  
  X_l=(X&0xff);
  X_h=((X>>8)&0xff);
  Y_l=(Y&0xff);
  Y_h=((Y>>8)&0xff);
  
  width_l=((width+X)&0xff);
  width_h=(((width+X)>>8)&0xff);
  height_l=((height+Y)&0xff);
  height_h=(((height+Y)>>8)&0xff);
  
  // set column range as full screen
  LMT028_Write_Cmd(0x2a); 
  LMT028_Write_Data(X_h);
  LMT028_Write_Data(X_l); 
  LMT028_Write_Data(width_h);
  LMT028_Write_Data(width_l); 
  
  // set row range as full screen
  LMT028_Write_Cmd(0x2b); 
  LMT028_Write_Data(Y_h);
  LMT028_Write_Data(Y_l); 
  LMT028_Write_Data(height_h);
  LMT028_Write_Data(height_l);
}

/**
* @brief 清除LMT028区域数据
* @param  X/Y:起始坐标   width：区域宽度  height;区域高度 
* @retval 无
*/
void clear_lcd_area(uint16_t X,uint16_t Y,uint16_t width,uint16_t height)
{
  uint32_t dp_y;
  uint32_t num;
  set_windows(X,Y,width,height);
  LMT028_Write_Cmd(0x2c);  
  num = width * height;
  for(dp_y = 0;dp_y < num;dp_y++){
    LMT028_Write_Data(0x00);
    LMT028_Write_Data(0x00);
  }
}

/**
* @brief  初始化LMT028寄存器
* @param  无
* @retval 无
*/
void LMT028_REG_Config ( void )
{
  // LMT028_Rst();
  LMT028_Write_Cmd ( 0x11  );
  Delay1ms  (150);
  
  //--------------------------------ST7789S Frame rate setting----------------------------------//
  LMT028_Write_Cmd ( 0xB2  );
  LMT028_Write_Data ( 0x0C  );
  LMT028_Write_Data ( 0x0C  );
  LMT028_Write_Data ( 0x00 );
  LMT028_Write_Data ( 0x33 );
  LMT028_Write_Data ( 0x33 );
  LMT028_Write_Data ( 0xB7 );
  LMT028_Write_Data ( 0x35 );
  
  ////---------------------------------ST7789S Fmark setting--------------------------------------//
  //        
  //        LMT028_Write_Cmd ( 0xB3  );
  //	LMT028_Write_Data ( 0x00  );
  //	LMT028_Write_Data ( 0x0f  );
  //	LMT028_Write_Data ( 0x0f );
  //        
  ////        
  //        SysCtlDelay(500); 
  //        LMT028_Write_Cmd ( 0xC6  );
  //	LMT028_Write_Data ( 0x1f);
  //	
  //---------------------------------ST7789S Power setting--------------------------------------//
  SysCtlDelay(500); 
  LMT028_Write_Cmd ( 0xBB);
  LMT028_Write_Data ( 0x28 );
  
  SysCtlDelay(500); 
  // mx,my,bgr,rev,ss,mh,mv,gs        
  LMT028_Write_Cmd ( 0xC0  );
  LMT028_Write_Data ( 0x2C );
  
  LMT028_Write_Cmd ( 0xC2  );
  LMT028_Write_Data ( 0x0f );
  
  SysCtlDelay(500); 
  //VRHS
  LMT028_Write_Cmd ( 0xC3  );
  LMT028_Write_Data ( 0x25);
  
  SysCtlDelay(500); 
  //VDV SET    
  LMT028_Write_Cmd ( 0xC4  );
  LMT028_Write_Data ( 0x20);
  
  SysCtlDelay(500); 
  // FRCTR2    
  LMT028_Write_Cmd ( 0xC6 );
  LMT028_Write_Data ( 0x0f);
  
  SysCtlDelay(500); 
  //regsel2 
  LMT028_Write_Cmd (0xCA);
  LMT028_Write_Data (0x0F );
  
  SysCtlDelay(500); 
  //regsel1
  LMT028_Write_Cmd ( 0xC8);
  LMT028_Write_Data ( 0x08 );
  
  SysCtlDelay(500); 
  // CABC
  LMT028_Write_Cmd ( 0x55);
  LMT028_Write_Data ( 0x90 );
  
  SysCtlDelay(500); 
  //PWCTRL1
  LMT028_Write_Cmd ( 0xd0);
  LMT028_Write_Data ( 0xa4 );
  LMT028_Write_Data ( 0xa1);
  
  SysCtlDelay(500); 
  //--------------------------------ST7789S gamma setting---------------------------------------//
  LMT028_Write_Cmd(0xe0);
  LMT028_Write_Data(0xd0);
  LMT028_Write_Data(0x03);
  LMT028_Write_Data(0x08);
  LMT028_Write_Data(0x0b);
  LMT028_Write_Data(0x0f);
  LMT028_Write_Data(0x2c);
  LMT028_Write_Data(0x41);
  LMT028_Write_Data(0x54);
  LMT028_Write_Data(0x4e);
  LMT028_Write_Data(0x07);
  LMT028_Write_Data(0x0e);
  LMT028_Write_Data(0x0c);
  LMT028_Write_Data(0x1e);
  LMT028_Write_Data(0x23); 
  
  SysCtlDelay(500); 
  LMT028_Write_Cmd(0xe1);
  LMT028_Write_Data(0xd0);
  LMT028_Write_Data(0x03);
  LMT028_Write_Data(0x09);
  LMT028_Write_Data(0x0b);
  LMT028_Write_Data(0x0d);
  LMT028_Write_Data(0x19);
  LMT028_Write_Data(0x3c);
  LMT028_Write_Data(0x54);
  LMT028_Write_Data(0x4f);
  LMT028_Write_Data(0x0e);
  LMT028_Write_Data(0x1d);
  LMT028_Write_Data(0x1c);
  LMT028_Write_Data(0x20);
  LMT028_Write_Data(0x22); 
  
  SysCtlDelay(500); 
  //65k色，16bit
  LMT028_Write_Cmd(0x3a);
  LMT028_Write_Data(0x55);
  
  SysCtlDelay(500); 
  //设置: MY=1, MX=1, MV=1(RowColEx), ML=0(normal), RGB=0(RGB)
  LMT028_Write_Cmd(0x36);
  //LMT028_Write_Data(0x60);  //信号线在右边  从左上到右下
  LMT028_Write_Data(0x60);
  
  SysCtlDelay(500); 
  //开启撕裂影响线
  LMT028_Write_Cmd(0x35);
  LMT028_Write_Data(0x00);
  
  SysCtlDelay(500); 
  
  //显示开
  LMT028_Write_Cmd(0x29);
  
  SysCtlDelay(500); 
  clear_lcd_area(0,0,320,240);      
}


/**
* @brief 设置填充lcd缓存模式  （以下缓存赋值以信号线为右边为标准）
* @param  show_type 赋值类型
* @retval 无
*/

void set_show_type(uint8_t show_type)
{
  switch(show_type)
  {
    //左上到右下
  case 1:
    {
      LMT028_Write_Cmd(0x36);
      LMT028_Write_Data(0x60);
      break;
    }
    
    //右上到左下
  case 2:
    {
      LMT028_Write_Cmd(0x36);
      LMT028_Write_Data(0x40);
      break;
    }
    
    //左下到右上
  case 3:
    {
      LMT028_Write_Cmd(0x36);
      LMT028_Write_Data(0x00);
      break;
    }
    
    //右下到左上
  case 4:
    {
      LMT028_Write_Cmd(0x36);
      LMT028_Write_Data(0x80);
      break;
    }
    
  }
}


/**
* @brief  Read the selected LCD register.
* @param  LCD_Reg: address of the selected register.
* @retval LCD register value
*/
uint16_t LCD_ReadReg(uint8_t LCD_Reg)
{
  uint16_t data;
  data = LCD->LCD_CMD; 
  return  data;
}



/**
* @brief  向LMT028写入命令
* @param  usData :要写入的命令（表寄存器地址）
* @retval 无
*/
void LMT028_Write_Cmd ( uint8_t usCmd )
{
  LCD->LCD_CMD=usCmd;	
}


/**
* @brief  向LMT028写入数据
* @param  usData :要写入数据（表寄存器地址）
* @retval 无
*/	
void LMT028_Write_Data ( uint8_t usData )
{
  LCD->LCD_DATA = usData;
}
/*!
* @brief	设置画笔颜色
* @param        Pen_Color 点的颜色
* @return	NONE
* @note	       NONE
*/
void Set_Pen_Color(uint16_t Pen_Color )
{
  POINT_COLOR=Pen_Color;
}

/*!
* @brief	设置背景颜色
* @param        Back_Color 颜色
* @return	NONE
* @note	       NONE
*/
void Set_Back_Color(uint16_t Pen_Color)
{
  BACK_COLOR=Pen_Color;
}

/*!
* @brief	画点
* @param 	x     坐标x
* @param 	y     坐标y
* @param        color 点的颜色
* @return	NONE
* @note	       NONE
*/
void LCD_DrawPoint(uint16_t x,uint16_t y,uint16_t color)
{
  uint8_t color_h,color_l;
  
  color_h=(color>>8)&0xff;
  color_l=color&0xff;
  
  set_coordinate(x,y);//设置光标位置
  
  LMT028_Write_Cmd(0x2c); 
  LMT028_Write_Data(color_h);
  LMT028_Write_Data(color_l);
}

/*!
* @brief   画线
* @param   x1,y1:起点坐标
* @param   x2,y2:结束坐标 
* @param   color:颜色 
* @return	NONE	
*/	  
void LCD_DrawLine(u16 x1,u16 y1,u16 x2,u16 y2,u16 color)
{         
  u16 t; 
  int xerr=0,yerr=0,delta_x,delta_y,distance; 
  int incx,incy,uRow,uCol; 
  delta_x=x2-x1; //计算坐标增量
  delta_y=y2-y1; 
  uRow=x1; 
  uCol=y1; 
  if(delta_x>0)
    incx=1; //设置单步方向
  else if(delta_x==0)
    incx=0;//垂直线
  else 
  {
    incx=-1;
    delta_x=-delta_x;
  } 
  if(delta_y>0)incy=1; 
  else if(delta_y==0)
    incy=0;//水平线 
  else
  {
    incy=-1;
    delta_y=-delta_y;
  } 
  if( delta_x>delta_y)
    distance=delta_x; //选取基本增量坐标轴
  else 
    distance=delta_y; 
  for(t=0;t<=distance+1;t++ )//画线输出
  {  
    LCD_DrawPoint(uRow,uCol,color);//画点
    xerr+=delta_x ; 
    yerr+=delta_y ; 
    if(xerr>distance) 
    { 
      xerr-=distance; 
      uRow+=incx; 
    } 
    if(yerr>distance) 
    { 
      yerr-=distance; 
      uCol+=incy; 
    } 
  }  
}


/*!
* @brief   显示字符串
* @param   x,y:起点坐标
* @param   width,height:区域大小 
* @param   *s:字符串起始地址
* @return	NONE	
*/
void LCD_ShowString(uint16_t x,uint16_t y, char *s)
{         
  char x0=x;
  while((*s<='~')&&(*s>=' '))//判断是不是非法字符
  {       
    if(x>=320)
    {
      x=x0;y+=16;
    }
    if(y>=240)
      break;//退出
    LCD_ShowChar(x,y,*s,16,0);
    x+=16/2;
    s++;
  }  
}

/*!
* @brief	在制定位置显示一个字符
* @param 	P 开始坐标以及宽度高度
* @param 	num:要显示的字符
* @param       size:字体大小  12/16/24
* @param       mode:叠加方式（1）  非叠加方式（0）
* @return	NONE	
*/
void LCD_ShowChar(uint16_t x,uint16_t y,uint16_t num,uint16_t size,uint16_t mode)
{  							  
  uint16_t temp,t1,t;
  uint16_t y0=y;
  uint16_t csize=(size/8+((size%8)?1:0))*(size/2); //得到一个字符对应点阵集所占的字节数	
  num=num-' ';//得到偏移后的值
  for(t=0;t<csize;t++)
  {   
    temp=ASCII_0816[num][t];
    for(t1=0;t1<8;t1++)
    {			    
      if(temp&0x80)
        LCD_DrawPoint(x,y,POINT_COLOR);
      else if(mode==0)
        LCD_DrawPoint(x,y,BACK_COLOR);
      temp<<=1;  
      y++;
      if((y-y0)==size)
      {
        y=y0;
        x++;
      }
    }  	 
  }  	    	   	 	  
}

/**
* @brief  延时1us
* @param  usData :要写入的命令（表寄存器地址）
* @retval 无
*/

void  Delay_1us(uint16_t k){
  uint32_t i;
  for (i=0;i<1*k;i++){
    SysCtlDelay(120000000/3300000);  //1us
  }
}


/**
* @brief  延时1ms
* @param  usData :要写入的命令（表寄存器地址）
* @retval 无
*/

void  Delay1ms(uint16_t k)
{
  uint32_t i;
  for (i=0;i<k;i++){
    Delay_1us(1000);  //1us
  }
}
